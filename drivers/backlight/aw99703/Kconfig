## drivers/input/touchscreen/touchscreen_mmi/Kconfig
```kconfig
config TOUCHSCREEN_MMI
	tristate "MMI touchscreen framework"
	default m

config INPUT_TOUCHSCREEN_MMI
	bool "MMI touchscreen glue for vendor drivers"
	depends on TOUCHSCREEN_MMI
	default y
	help
	  Compile the touchscreen_mmi glue layer into MMI touchscreen
	  drivers (goodix, synaptics, etc). This enables registration of
	  the per-driver device with the MMI touchscreen framework.
```

## drivers/misc/awinic/Kconfig
```kconfig
config AWINIC_SAR
	tristate "Awinic SAR sensor driver"
	depends on I2C
	help
	  Say Y or M here if you want to support Awinic SAR sensors.
```

## drivers/power/mmi_charger/Kconfig
```kconfig
config MMI_CHARGER
	tristate "Motorola MMI charger driver"
	default m
	help
	  Say M here if you want to build the Motorola MMI charger driver.
```

## drivers/power/qti_glink_charger/Kconfig
```kconfig
config QTI_GLINK_CHARGER
	tristate "QTI glink charger driver"
	default m
	help
	  Say M here if you want to build the QTI glink charger driver.
```

## drivers/watchdog_cpu_ctx/Kconfig
```kconfig
config MMI_WATCHDOG_CPU_CTX
	tristate "MMI watchdog CPU context driver"
	default m
```
